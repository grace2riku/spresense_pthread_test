## pthread_barrier_wait/Kconfig
```kconfig
config SPRESENSE_PTHREAD_TEST_PTHREAD_BARRIER_WAIT
	tristate "“pthread_barrier_wait_test”"
	default y
	---help---
		Enable the pthread_barrier_wait app

if SPRESENSE_PTHREAD_TEST_PTHREAD_BARRIER_WAIT

config SPRESENSE_PTHREAD_TEST_PTHREAD_BARRIER_WAIT_PROGNAME
	string "Program name"
	default "pthread_barrier_wait"
	---help---
		This is the name of the program that will be use when the NSH ELF
		program is installed.

config SPRESENSE_PTHREAD_TEST_PTHREAD_BARRIER_WAIT_PRIORITY
	int "pthread_barrier_wait task priority"
	default 100

config SPRESENSE_PTHREAD_TEST_PTHREAD_BARRIER_WAIT_STACKSIZE
	int "pthread_barrier_wait stack size"
	default 2048

endif
```

## pthread_cond/Kconfig
```kconfig
config SPRESENSE_PTHREAD_TEST_PTHREAD_COND
	tristate "“cond_test”"
	default y
	---help---
		Enable the pthread_cond app

if SPRESENSE_PTHREAD_TEST_PTHREAD_COND

config SPRESENSE_PTHREAD_TEST_PTHREAD_COND_PROGNAME
	string "Program name"
	default "pthread_cond"
	---help---
		This is the name of the program that will be use when the NSH ELF
		program is installed.

config SPRESENSE_PTHREAD_TEST_PTHREAD_COND_PRIORITY
	int "pthread_cond task priority"
	default 100

config SPRESENSE_PTHREAD_TEST_PTHREAD_COND_STACKSIZE
	int "pthread_cond stack size"
	default 2048

endif
```

## pthread_cond_broadcast/Kconfig
```kconfig
config SPRESENSE_PTHREAD_TEST_PTHREAD_COND_BROADCAST
	tristate "“cond_broadcast_test”"
	default y
	---help---
		Enable the pthread_cond_broadcast app

if SPRESENSE_PTHREAD_TEST_PTHREAD_COND_BROADCAST

config SPRESENSE_PTHREAD_TEST_PTHREAD_COND_BROADCAST_PROGNAME
	string "Program name"
	default "pthread_cond_broadcast"
	---help---
		This is the name of the program that will be use when the NSH ELF
		program is installed.

config SPRESENSE_PTHREAD_TEST_PTHREAD_COND_BROADCAST_PRIORITY
	int "pthread_cond_broadcast task priority"
	default 100

config SPRESENSE_PTHREAD_TEST_PTHREAD_COND_BROADCAST_STACKSIZE
	int "pthread_cond_broadcast stack size"
	default 2048

endif
```

## pthread_cond_timeout/Kconfig
```kconfig
config SPRESENSE_PTHREAD_TEST_PTHREAD_COND_TIMEOUT
	tristate "“cond_timeout_test”"
	default y
	---help---
		Enable the pthread_cond_timeout app

if SPRESENSE_PTHREAD_TEST_PTHREAD_COND_TIMEOUT

config SPRESENSE_PTHREAD_TEST_PTHREAD_COND_TIMEOUT_PROGNAME
	string "Program name"
	default "pthread_cond_timeout"
	---help---
		This is the name of the program that will be use when the NSH ELF
		program is installed.

config SPRESENSE_PTHREAD_TEST_PTHREAD_COND_TIMEOUT_PRIORITY
	int "pthread_cond_timeout task priority"
	default 100

config SPRESENSE_PTHREAD_TEST_PTHREAD_COND_TIMEOUT_STACKSIZE
	int "pthread_cond_timeout stack size"
	default 2048

endif
```

## pthread_douzodouzo/Kconfig
```kconfig
config SPRESENSE_PTHREAD_TEST_PTHREAD_DOUZODOUZO
	tristate "“pthread_douzodouzo_test”"
	default y
	---help---
		Enable the pthread_douzodouzo app

if SPRESENSE_PTHREAD_TEST_PTHREAD_DOUZODOUZO

config SPRESENSE_PTHREAD_TEST_PTHREAD_DOUZODOUZO_PROGNAME
	string "Program name"
	default "pthread_douzodouzo"
	---help---
		This is the name of the program that will be use when the NSH ELF
		program is installed.

config SPRESENSE_PTHREAD_TEST_PTHREAD_DOUZODOUZO_PRIORITY
	int "pthread_douzodouzo task priority"
	default 100

config SPRESENSE_PTHREAD_TEST_PTHREAD_DOUZODOUZO_STACKSIZE
	int "pthread_douzodouzo stack size"
	default 2048

endif
```

## pthread_first_test_app/Kconfig
```kconfig
config PTHREAD_FIRST_TEST_PTHREAD_FIRST_TEST_APP
	tristate "My first pthread test app"
	default y
	---help---
		Enable the pthread_first_test_app app

if PTHREAD_FIRST_TEST_PTHREAD_FIRST_TEST_APP

config PTHREAD_FIRST_TEST_PTHREAD_FIRST_TEST_APP_PROGNAME
	string "Program name"
	default "pthread_first_test_app"
	---help---
		This is the name of the program that will be use when the NSH ELF
		program is installed.

config PTHREAD_FIRST_TEST_PTHREAD_FIRST_TEST_APP_PRIORITY
	int "pthread_first_test_app task priority"
	default 100

config PTHREAD_FIRST_TEST_PTHREAD_FIRST_TEST_APP_STACKSIZE
	int "pthread_first_test_app stack size"
	default 2048

endif
```

## pthread_mutex/Kconfig
```kconfig
config PTHREAD_TEST_PTHREAD_MUTEX
	tristate "“pthreads_mutex_test_app”"
	default y
	---help---
		Enable the pthread_mutex app

if PTHREAD_TEST_PTHREAD_MUTEX

config PTHREAD_TEST_PTHREAD_MUTEX_PROGNAME
	string "Program name"
	default "pthread_mutex"
	---help---
		This is the name of the program that will be use when the NSH ELF
		program is installed.

config PTHREAD_TEST_PTHREAD_MUTEX_PRIORITY
	int "pthread_mutex task priority"
	default 100

config PTHREAD_TEST_PTHREAD_MUTEX_STACKSIZE
	int "pthread_mutex stack size"
	default 2048

endif
```
